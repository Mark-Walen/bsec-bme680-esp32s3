## main/Kconfig.projbuild
```kconfig
menu "BME680 Configuration"
        
    choice BME680_IAQ_CONFIG
        prompt "Select BME680 iaq configuration"
        default BME680_IAQ_33V_3S_4D

        config BME680_IAQ_33V_3S_4D
            bool  "BME680_IAQ_33v_3s_4d"
            help
                MAX data sample rate 3s, calibration time 4 days
        config BME680_IAQ_33V_300S_4D
            bool  "BME680_IAQ_33v_300s_4d"
            help
                MAX data sample rate 300s, calibration time 4 days
    endchoice

    menu "WIFI Configuration"
        config ESP_WIFI_SSID
            string "WiFi SSID"
            default "bme680"
            help
                SSID (network name) for the example to connect to.
    
        config ESP_WIFI_PASSWORD
            string "WiFi Password"
            default "mypassword"
            help
                WiFi password (WPA or WPA2) for the example to use.
    
        config ESP_MAXIMUM_RETRY
            int "Maximum retry"
            default 5
            help
                Set the Maximum retry to avoid station reconnecting to the AP unlimited when the AP is really inexistent.
    
        choice ESP_WIFI_SCAN_AUTH_MODE_THRESHOLD
            prompt "WiFi Scan auth mode threshold"
            default ESP_WIFI_AUTH_WPA2_PSK
            help
                The weakest authmode to accept in the scan mode.
                This value defaults to ESP_WIFI_AUTH_WPA2_PSK incase password is present and ESP_WIFI_AUTH_OPEN is used.
                Please select ESP_WIFI_AUTH_WEP/ESP_WIFI_AUTH_WPA_PSK incase AP is operating in WEP/WPA mode.
    
            config ESP_WIFI_AUTH_OPEN
                bool "OPEN"
            config ESP_WIFI_AUTH_WEP
                bool "WEP"
            config ESP_WIFI_AUTH_WPA_PSK
                bool "WPA PSK"
            config ESP_WIFI_AUTH_WPA2_PSK
                bool "WPA2 PSK"
            config ESP_WIFI_AUTH_WPA_WPA2_PSK
                bool "WPA/WPA2 PSK"
            config ESP_WIFI_AUTH_WPA3_PSK
                bool "WPA3 PSK"
            config ESP_WIFI_AUTH_WPA2_WPA3_PSK
                bool "WPA2/WPA3 PSK"
            config ESP_WIFI_AUTH_WAPI_PSK
                bool "WAPI PSK"
        endchoice
    endmenu

    menu "MQTT Configuration"
        config BROKER_URL
            string "Broker URL"
            default "mqtt://mqtt.eclipseprojects.io"
            help
                URL of the broker to connect to
    
        config BROKER_URL_FROM_STDIN
            bool
            default y if BROKER_URL = "FROM_STDIN"
    endmenu

endmenu
```
